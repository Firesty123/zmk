## app/boards/arm/ssk/Kconfig
```kconfig
# SPDX-License-Identifier: MIT

config BOARD_SSK_LEFT
    bool

config BOARD_SSK_RIGHT
    bool
```

## app/boards/arm/ssk/Kconfig.board
```kconfig
# Smart Split Keyboard configuration

# Copyright (c) 2021 Pete Johanson
# SPDX-License-Identifier: MIT

config BOARD_SSK_LEFT
    bool "SSK Left"
    depends on SOC_NRF52833_QIAA
    select BOARD_SSK_LEFT

config BOARD_SSK_RIGHT
    bool "SSK Right"
    depends on SOC_NRF52833_QIAA
    select BOARD_SSK_RIGHT
```

## app/boards/arm/ssk/Kconfig.defconfig
```kconfig
# Copyright (c) 2020 Pete Johanson
# SPDX-License-Identifier: MIT

if BOARD_SSK_LEFT

config ZMK_KEYBOARD_NAME
	default "SSK FYP"

config ZMK_SPLIT_ROLE_CENTRAL
	default y

endif

if BOARD_SSK_LEFT || BOARD_SSK_RIGHT

config BOARD
	default "ssk"

config ZMK_SPLIT
	default y

if USB

config USB_NRFX
	default y

config USB_DEVICE_STACK
	default y

endif # USB

config BT_CTLR
	default BT

config ZMK_BLE
	default y

config ZMK_USB
	default y

endif # BOARD_SSK_LEFT || BOARD_SSK_RIGHT
```

## app/boards/arm/ssk/ssk_right_defconfig
```kconfig
# SPDX-License-Identifier: MIT

CONFIG_SOC_SERIES_NRF52X=y
CONFIG_SOC_NRF52833_QIAA=y
CONFIG_BOARD_SSK_RIGHT=y
CONFIG_ZMK_SLEEP=y

# Enable MPU
CONFIG_ARM_MPU=y

# enable GPIO
CONFIG_GPIO=y

# enable pinctrl
CONFIG_PINCTRL=y

# Enable SPI
CONFIG_SPI_NRFX=y

# Enable writing to flash
CONFIG_USE_DT_CODE_PARTITION=y
CONFIG_BUILD_OUTPUT_UF2=y

CONFIG_MPU_ALLOW_FLASH_WRITE=y
CONFIG_NVS=y
CONFIG_SETTINGS_NVS=y
CONFIG_FLASH=y
CONFIG_FLASH_PAGE_LAYOUT=y
CONFIG_FLASH_MAP=y
```
